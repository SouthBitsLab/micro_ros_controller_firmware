## app-manifest/west.yml
```yaml
# Copyright (c) 2021 Nordic Semiconductor ASA
# SPDX-License-Identifier: Apache-2.0

manifest:
  remotes:
    - name: zephyrproject-rtos
      url-base: https://github.com/SouthBitsLab

    - name: micro-ROS
      url-base: https://github.com/SouthBitsLab

  projects:
    - name: zephyr
      remote: zephyrproject-rtos
      revision: v4.1.0-micro-ros-controller
      import: true

    - name: micro_ros_zephyr_module
      remote: micro-ROS
      repo-path: micro_ros_zephyr_module
      revision: jazzy_posix_fix
      path: micro_ros_zephyr_module

  self:
    path: app-manifest
```
